## platforms/embedded/esp32-idf-wasi/sdkconfig.defaults
```kconfig
# Increased stack size
CONFIG_ESP_MAIN_TASK_STACK_SIZE=65536

# Disable task watchdog
CONFIG_ESP_TASK_WDT=n

# Increase CPU frequency
CONFIG_ESP32_DEFAULT_CPU_FREQ_240=y

# PSRAM support
CONFIG_SPIRAM_SUPPORT=y
CONFIG_SPIRAM_IGNORE_NOTFOUND=y
CONFIG_SPIRAM_USE_MALLOC=y

# Enable Core Dump
CONFIG_ESP_COREDUMP_ENABLE=y
CONFIG_ESP_COREDUMP_TO_FLASH_OR_UART=y
CONFIG_ESP_COREDUMP_DATA_FORMAT_ELF=y
CONFIG_ESP_COREDUMP_UART_OR_FLASH_SIZE=0x10000

# Debug settings
CONFIG_COMPILER_OPTIMIZATION_DEBUG=y
CONFIG_COMPILER_OPTIMIZATION_ASSERTIONS_ENABLE=y
CONFIG_OPTIMIZATION_ASSERTION_LEVEL=2

# Stack debug
CONFIG_FREERTOS_WATCHPOINT_END_OF_STACK=y
CONFIG_FREERTOS_INTERRUPT_BACKTRACE=y
CONFIG_FREERTOS_GENERATE_RUN_TIME_STATS=y
```
